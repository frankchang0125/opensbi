## lib/sbi/Kconfig
```kconfig
# SPDX-License-Identifier: BSD-2-Clause

menu "Generic SBI Support"

config CONSOLE_EARLY_BUFFER_SIZE
	int "Early console buffer size (bytes)"
	default 256

config SBI_ECALL_TIME
	bool "Timer extension"
	default y

config SBI_ECALL_RFENCE
	bool "RFENCE extension"
	default y

config SBI_ECALL_IPI
	bool "IPI extension"
	default y

config SBI_ECALL_HSM
	bool "Hart State Management extension"
	default y

config SBI_ECALL_SRST
	bool "System Reset extension"
	default y

config SBI_ECALL_SUSP
	bool "System Suspend extension"
	default y

config SBI_ECALL_PMU
	bool "Performance Monitoring Unit extension"
	default y

config SBI_ECALL_DBCN
	bool "Debug Console extension"
	default y

config SBI_ECALL_CPPC
	bool "CPPC extension"
	default y

config SBI_ECALL_FWFT
	bool "Firmware Feature extension"
	default y

config SBI_DOMAIN_CONTEXT
	bool "Domain context switching support (experimental)"
	default n
	help
	  Enable support for domain context management, which provides
	  infrastructure for domain context switching. This feature is
	  currently experimental and not used by any standard SBI extensions.

	  This adds context save/restore capabilities to allow runtime
	  switching of HARTs between different security domains, which is
	  useful for implementing secure domain suspension/resumption and
	  CPU time-sharing between isolated domains.

	  If unsure, say N.

config SBI_ECALL_LEGACY
	bool "SBI v0.1 legacy extensions"
	default y

config SBI_ECALL_VENDOR
	bool "Platform-defined vendor extensions"
	default y

config SBI_ECALL_DBTR
	bool "Debug Trigger Extension"
	default y

config SBIUNIT
	bool "Enable SBIUNIT tests"
	default n

config SBI_ECALL_SSE
	bool "SSE extension"
	default y

config SBI_ECALL_MPXY
	bool "MPXY extension"
	default y
endmenu
```
